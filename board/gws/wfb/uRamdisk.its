## board/gws/wfb/uRamdisk.its
```
/dts-v1/;

/ {
	description = "wfb kernel image";
	#address-cells = <1>;

	images {
		bootscript@1 {
			description = "wfb bootscript";
			data = /incbin/("u-boot.scr");
			type = "script";
			arch = "arm";
			os = "u_boot";
			compression = "none";
			load = <00000000>;
			entry = <00000000>;
			hash@1{
				algo="sha1";
			};
		};
		kernel@1 {
			description = "wfb linux kernel";
			data = /incbin/("zImage");
			type = "kernel";
			arch = "arm";
			os = "linux";
			compression = "none";
			load = <0x00008000>;
			entry = <0x00008000>;
			hash@1 {
				algo = "sha1";
			};
		};
		ramdisk@1 {
			description = "wfb ramdisk";
			data = /incbin/("rootfs.cpio.xz");
			type = "ramdisk";
			arch = "arm";
			os = "linux";
			compression = "none";
			load = <00000000>;
			entry = <00000000>;
			hash@1{
				algo="sha1";
			};
		};
	};

	configurations {
		description = "wfb configurations";
		default = "conf@1";
		conf@1 {
			description = "wfb default configuration";
			bootscript = "bootscript@1";
			kernel = "kernel@1";
			ramdisk = "ramdisk@1";
			/*signature@1 {
				algo = "sha1,rsa2048";
				key-name-hint = "kernel";
				sign-images = "bootscript","kernel","ramdisk";
			};*/
		};
	};

};
```

## configs/gws_wfb_defconfig
```kconfig
BR2_arm=y
BR2_cortex_a9=y
BR2_ARM_ENABLE_VFP=y
BR2_ARM_INSTRUCTIONS_THUMB2=y
BR2_HOST_DIR="$(BASE_DIR)/arm-linux-uclibc-gnueabihf"
BR2_KERNEL_MIRROR="https://www.kernel.org/pub"
BR2_GNU_MIRROR="http://ftp.gnu.org/pub/gnu"
BR2_CCACHE=y
# BR2_COMPILER_PARANOID_UNSAFE_PATH is not set
BR2_KERNEL_HEADERS_3_4=y
BR2_TOOLCHAIN_BUILDROOT_INET_RPC=y
BR2_BINUTILS_VERSION_2_25_X=y
BR2_GCC_VERSION_4_9_X=y
BR2_TOOLCHAIN_BUILDROOT_CXX=y
BR2_PACKAGE_HOST_GDB=y
BR2_TARGET_GENERIC_ROOT_PASSWD="thinkgreen"
BR2_TARGET_GENERIC_GETTY_BAUDRATE_115200=y
BR2_ROOTFS_OVERLAY="board/gws/wfb/rootfs"
BR2_ROOTFS_POST_BUILD_SCRIPT="board/gws/wfb/post_build.sh"
BR2_ROOTFS_POST_IMAGE_SCRIPT="board/gws/wfb/post_image.sh"
BR2_LINUX_KERNEL=y
BR2_LINUX_KERNEL_CUSTOM_VERSION=y
BR2_LINUX_KERNEL_CUSTOM_VERSION_VALUE="3.4.108"
BR2_LINUX_KERNEL_PATCH="board/gws/wfb/patches/linux/{linux-3.4.108_*.patch,linux-3.4.108-x10dr_*.patch}"
BR2_LINUX_KERNEL_USE_CUSTOM_CONFIG=y
BR2_LINUX_KERNEL_CUSTOM_CONFIG_FILE="board/gws/wfb/linux.config"
BR2_PACKAGE_BUSYBOX_CONFIG="board/gws/wfb/busybox.config"
BR2_PACKAGE_BUSYBOX_SHOW_OTHERS=y
BR2_PACKAGE_RTL8814=y
BR2_TARGET_RTL8814_PATCH="board/gws/wfb/patches/rtl8814/{rtl8194_driver-v1.6_20151022.001_*.patch,rtl8194_driver-v1.6_20151022.001-x10dr_*.patch}"
BR2_PACKAGE_UBOOT_TOOLS=y
BR2_PACKAGE_LIBPCAP=y
BR2_PACKAGE_DROPBEAR=y
BR2_PACKAGE_WIRELESS_TOOLS=y
BR2_PACKAGE_DASH=y
BR2_TARGET_ROOTFS_CPIO=y
BR2_TARGET_ROOTFS_CPIO_XZ=y
# BR2_TARGET_ROOTFS_TAR is not set
BR2_TARGET_ROOTFS_UBIFS=y
BR2_TARGET_ROOTFS_UBIFS_LEBSIZE=0x1f000
BR2_TARGET_ROOTFS_UBIFS_MAXLEBCNT=4095
BR2_TARGET_ROOTFS_UBIFS_RT_ZLIB=y
BR2_TARGET_ROOTFS_UBIFS_OPTS="-U --space-fixup"
BR2_TARGET_ROOTFS_UBI=y
BR2_TARGET_ROOTFS_UBI_SUBSIZE=0
BR2_TARGET_ROOTFS_UBI_USE_CUSTOM_CONFIG=y
BR2_TARGET_ROOTFS_UBI_CUSTOM_CONFIG_FILE="board/gws/wfb/ubinize.cfg"
BR2_TARGET_UBOOT=y
BR2_TARGET_UBOOT_BOARDNAME="g2_x10dr"
BR2_TARGET_UBOOT_CUSTOM_VERSION=y
BR2_TARGET_UBOOT_CUSTOM_VERSION_VALUE="2014.07"
BR2_TARGET_UBOOT_PATCH="board/gws/wfb/patches/u-boot/{u-boot-2014.07_*.patch,u-boot-2014.07-x10dr_*.patch}"
BR2_TARGET_UBOOT_NEEDS_DTC=y
BR2_TARGET_UBOOT_FORMAT_DTB_BIN=y
BR2_PACKAGE_HOST_MTD=y
BR2_PACKAGE_HOST_UBOOT_TOOLS=y
BR2_PACKAGE_HOST_UBOOT_TOOLS_FIT_SUPPORT=y
BR2_PACKAGE_HOST_UBOOT_TOOLS_FIT_SIGNATURE_SUPPORT=y
```

## lego/Config.in
```kconfig
menu "Lego"

	source "lego/qcsapi_client/Config.in"
	source "lego/rtl8814/Config.in"

endmenu
```

## lego/qcsapi_client/Config.in
```kconfig
comment "Quantenna qcsapi client"

config BR2_PACKAGE_QCSAPI_CLIENT
	bool "qcsapi_client"
	help
	  Quantenna qcsapi client
```

## lego/rtl8814/Config.in
```kconfig
comment "rtl8814 needs a Linux kernel to be built"
	depends on !BR2_LINUX_KERNEL

config BR2_PACKAGE_RTL8814
	bool "rtl8814"
	depends on BR2_LINUX_KERNEL
	help
	  rtl8814 wifi driver

if	BR2_PACKAGE_RTL8814

config BR2_TARGET_RTL8814_PATCH
	string "Custom RTL8814 patches"
	help
	  A space-separated list of patches to apply to rtl8814 driver.
	  Each patch can be described as an URL, a local file path,
	  or a directory. In the case of a directory, all files
	  matching *.patch in the directory will be applied.

	  Most users may leave this empty

endif
```

## package/bwping/Config.in
```kconfig
config BR2_PACKAGE_BWPING
	bool "bwping"
	help
	BWPing is a tool to measure bandwidth and response times between two
	hosts using Internet Control Message Protocol (ICMP) echo request/echo
	reply mechanism

	http://bwping.sourceforge.net/
```

## package/iometer/Config.in
```kconfig
config BR2_PACKAGE_IOMETER
	bool "iometer"
	help
		An I/O subsystem measurement and characterization tool for single and clustered systems. 
		http://www.iometer.org/
```

## package/iozone/Config.in
```kconfig
config BR2_PACKAGE_IOZONE
	bool "iozone"
	help
	  A filesystem benchmark tool for performing a broad filesystem analysis
	  of a vendor computer platform

	  http://www.iozone.org
```

## package/udev/Config.in
```kconfig
config BR2_PACKAGE_UDEV
	bool "udev"
	depends on BR2_ROOTFS_DEVICE_CREATION_DYNAMIC_UDEV
	help
	  Userspace device daemon.

	  ftp://ftp.kernel.org/pub/linux/utils/kernel/hotplug/

comment "udev requires /dev mgmnt set to udev under System configuration"
	depends on !BR2_ROOTFS_DEVICE_CREATION_DYNAMIC_UDEV
```
